## firmware/radio/sdkconfig.defaults
```kconfig
# Bluetooth Configuration for ESP32-C6 (NimBLE)
CONFIG_BT_ENABLED=y
CONFIG_BT_NIMBLE_ENABLED=y
CONFIG_BT_BLUEDROID_ENABLED=n

# NimBLE Options
CONFIG_BT_NIMBLE_ROLE_PERIPHERAL=y
CONFIG_BT_NIMBLE_ROLE_CENTRAL=n
CONFIG_BT_NIMBLE_ROLE_BROADCASTER=y

# NimBLE Host
CONFIG_BT_NIMBLE_MAX_CONNECTIONS=1
CONFIG_BT_NIMBLE_PINNED_TO_CORE_0=y

# BLE Features
CONFIG_BT_NIMBLE_BLE_POWER_CONTROL_ENABLED=y
# CONFIG_BT_NIMBLE_EXT_ADV is not set

# Power Management - Allow BLE to use dynamic frequency scaling
CONFIG_BT_CTRL_BLE_MAX_ACT=4
CONFIG_BT_CTRL_BLE_STATIC_ACL_TX_BUF_NB=2
CONFIG_BT_LE_RELEASE_IRAM_SUPPORTED=y

# Enable BLE sleep mode
CONFIG_BT_LE_SLEEP_ENABLE=y
CONFIG_BT_CTRL_SLEEP_MODE_EFF=y
CONFIG_BT_CTRL_SLEEP_CLOCK_EFF=y
CONFIG_BT_CTRL_LOW_POWER_CLOCK=y

# Logging
CONFIG_LOG_DEFAULT_LEVEL_INFO=y
CONFIG_LOG_MAXIMUM_LEVEL_DEBUG=y

# FreeRTOS
CONFIG_FREERTOS_HZ=1000
```
